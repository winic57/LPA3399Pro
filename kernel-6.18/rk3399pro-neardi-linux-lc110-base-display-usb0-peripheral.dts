/dts-v1/;

/include/ "rk3399pro-neardi-linux-lc110-base-display.dts"

/ {
	model = "Neardi LPA3399Pro LC110 base display USB0 peripheral A/B";
};

/*
 * A/B-only variant: align DWC3 USB0 GCTL.PRTCAP with vendor 4.4 golden
 * device/peripheral state while the USB2PHY0 host-keepalive quirk keeps the
 * NPU-facing HS host companion electrically active.
 */
&{/usb@fe800000/usb@fe800000} {
	dr_mode = "peripheral";
	/delete-property/ usb-role-switch;
	/delete-property/ role-switch-default-mode;
};
